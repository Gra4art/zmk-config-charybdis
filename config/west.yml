## config/west.yml
```yaml
manifest:
  defaults:
    remote: zmkfirmware

  remotes:
    - name: zmkfirmware
      url-base: https://github.com/zmkfirmware
    - name: badjeff
      url-base: https://github.com/badjeff

  projects:
    - name: zmk
      revision: main  
      import: true
    - name: zmk-pmw3610-driver
      remote: badjeff
      revision: main
      path: modules/zmk-pmw3610-driver

  self:
    path: config
```
